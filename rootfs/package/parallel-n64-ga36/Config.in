## rootfs/package/parallel-n64-ga36/Config.in
```kconfig
config BR2_PACKAGE_PARALLEL_N64_GA36
	bool "parallel-n64 for GA36 / goodluckOS (experimental)"
	depends on BR2_arm
	depends on BR2_INSTALL_LIBSTDCPP
	depends on BR2_PACKAGE_MESA3D_OPENGL_ES
	select BR2_PACKAGE_ZLIB
	help
	  Cross-build ParaLLEl N64 using goodluckOS Buildroot's ARMv7
	  hard-float toolchain and Mesa GLESv2 sysroot. Experimental:
	  compilation and runtime operation have not been verified.
```
